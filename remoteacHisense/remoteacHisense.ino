#include <ESP8266WiFi.h>
#include <IRremoteESP8266.h>
#include <IRsend.h>
#include <ArduinoJson.h>
#include <ESP8266HTTPClient.h>

// WiFi Configuration
const char* ssid = "Tselhome-7A14";
const char* password = "81190678";

// Server Configuration
const String baseURL = "http://192.168.8.106:8080/api/payloads/DEV017";
const unsigned long HTTP_TIMEOUT = 5000;  // HTTP timeout (ms)
const unsigned long UPDATE_INTERVAL = 5000;  // Data fetch interval (ms)
const int MAX_HTTP_RETRIES = 3;  // Maximum HTTP retries

// IR Pin and Frequency
const uint16_t kIrLedPin = 4;  // GPIO4 = D2 on NodeMCU
const uint16_t kFrequency = 38;  // IR carrier frequency (kHz, typical for COOLIX)
IRsend irsend(kIrLedPin);

// IR Command Structure
struct IRCommand {
  const char* name;
  const uint16_t* rawData;  // Pointer to raw data array
  size_t rawLength;         // Length of raw data array
  const char* description;
};

// Raw IR Data (Hardcoded)
const uint16_t rawPowerOn[] = {9010, 4454, 552, 1710, 532, 1714, 532, 544, 554, 548, 554, 552, 554,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 568, 496};
const uint16_t rawPowerOff[] = {9016, 4456, 554, 1710, 532, 1714, 534, 544, 556, 548, 554, 552, 554,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 570, 494};
const uint16_t rawTemp16[] = {8992, 4452, 556, 1706, 532, 1714, 532, 544, 552, 550, 556, 550, 554,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 570, 496};
const uint16_t rawTemp17[] = {9008, 4476, 534, 1708, 534, 1712, 532, 546, 554, 548, 554, 552, 554,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 570, 496};
const uint16_t rawTemp18[] = {9008, 4476, 534, 1708, 534, 1712, 532, 546, 554, 548, 554, 552, 554,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 570, 496};
const uint16_t rawTemp19[] = {9010, 4454, 554, 1708, 534, 1714, 534, 544, 556, 548, 554, 552, 556,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 570, 494};
const uint16_t rawTemp20[] = {9012, 4452, 554, 1708, 532, 1714, 536, 542, 554, 548, 556, 550, 554,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 568, 496};
const uint16_t rawTemp21[] = {9014, 4450, 558, 1706, 534, 1712, 532, 544, 556, 546, 554, 552, 556,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 570, 494};
const uint16_t rawTemp22[] = {9012, 4472, 534, 1708, 536, 1710, 534, 544, 556, 546, 554, 552, 554,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 570, 504};
const uint16_t rawTemp23[] = {9014, 4450, 530, 1734, 508, 1738, 508, 568, 532, 572, 530, 576, 530,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 568, 496};
const uint16_t rawTemp24[] = {9014, 4450, 530, 1734, 534, 1712, 508, 568, 532, 572, 530, 576, 530,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 570, 520};
const uint16_t rawTemp25[] = {9018, 4450, 530, 1734, 506, 1740, 508, 568, 530, 572, 530, 576, 532,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 570, 496};

// IR Command Lists
IRCommand powerCommands[] = {
  { "on", rawPowerOn, sizeof(rawPowerOn) / sizeof(rawPowerOn[0]), "Power ON" },
  { "off", rawPowerOff, sizeof(rawPowerOff) / sizeof(rawPowerOff[0]), "Power OFF" },
};

IRCommand tempCommands[] = {
  { "16", rawTemp16, sizeof(rawTemp16) / sizeof(rawTemp16[0]), "Temperature 16°C" },
  { "17", rawTemp17, sizeof(rawTemp17) / sizeof(rawTemp17[0]), "Temperature 17°C" },
  { "18", rawTemp18, sizeof(rawTemp18) / sizeof(rawTemp18[0]), "Temperature 18°C" },
  { "19", rawTemp19, sizeof(rawTemp19) / sizeof(rawTemp19[0]), "Temperature 19°C" },
  { "20", rawTemp20, sizeof(rawTemp20) / sizeof(rawTemp20[0]), "Temperature 20°C" },
  { "21", rawTemp21, sizeof(rawTemp21) / sizeof(rawTemp21[0]), "Temperature 21°C" },
  { "22", rawTemp22, sizeof(rawTemp22) / sizeof(rawTemp22[0]), "Temperature 22°C" },
  { "23", rawTemp23, sizeof(rawTemp23) / sizeof(rawTemp23[0]), "Temperature 23°C" },
  { "24", rawTemp24, sizeof(rawTemp24) / sizeof(rawTemp24[0]), "Temperature 24°C" },
  { "25", rawTemp25, sizeof(rawTemp25) / sizeof(rawTemp25[0]), "Temperature 25°C" },
};

// Last States
String lastPowerState = "";
String lastTempState = "";

// Timing Variables
unsigned long lastUpdate = 0;

void logMessage(const String& message) {
  Serial.printf("[%.3f] %s\n", millis() / 1000.0, message.c_str());
}

void connectToWiFi() {
  logMessage("Connecting to WiFi...");
  WiFi.begin(ssid, password);

  while (WiFi.status() != WL_CONNECTED) {
    delay(500);
    Serial.print(".");
  }
  logMessage("Connected to WiFi! IP Address: " + WiFi.localIP().toString());
}

void ensureWiFiConnected() {
  if (WiFi.status() != WL_CONNECTED) {
    logMessage("WiFi disconnected, reconnecting...");
    connectToWiFi();
  }
}

String getPayload() {
  HTTPClient http;
  WiFiClient client;
  String payload = "";
  int retryCount = 0;

  http.setTimeout(HTTP_TIMEOUT);

  while (retryCount < MAX_HTTP_RETRIES) {
    http.begin(client, baseURL);
    int httpCode = http.GET();

    if (httpCode == HTTP_CODE_OK) {
      payload = http.getString();
      logMessage("Received payload: " + payload);
      http.end();
      return payload;
    } else {
      logMessage("HTTP request failed, error: " + String(http.errorToString(httpCode)));
      retryCount++;
      delay(1000);  // Wait before retry
    }
    http.end();
  }

  logMessage("Max HTTP retries reached, returning empty payload");
  return "";
}

bool findAndSend(const String& cmd, IRCommand* commands, size_t count, String& lastState) {
  for (size_t i = 0; i < count; i++) {
    if (cmd == commands[i].name) {
      if (cmd == lastState) {
        logMessage("Command " + cmd + " ignored (same state)");
        return true;
      }
      irsend.sendRaw(commands[i].rawData, commands[i].rawLength, kFrequency);
      logMessage("Sending: " + String(commands[i].description));
      lastState = cmd;
      return true;
    }
  }
  return false;
}

void processCommand(const String& cmd) {
  if (findAndSend(cmd, powerCommands, sizeof(powerCommands) / sizeof(powerCommands[0]), lastPowerState)) return;
  if (findAndSend(cmd, tempCommands, sizeof(tempCommands) / sizeof(tempCommands[0]), lastTempState)) return;

  logMessage("Unrecognized command: " + cmd);
}

void processPayload(const String& payload) {
  if (payload.isEmpty()) {
    logMessage("Empty payload received");
    return;
  }

  DynamicJsonDocument doc(1024);
  DeserializationError error = deserializeJson(doc, payload);

  if (error) {
    logMessage("JSON parsing failed: " + String(error.c_str()));
    logMessage("Raw payload: " + payload);
    return;
  }

  JsonArray devicesArray = doc.as<JsonArray>();
  if (devicesArray.isNull() || devicesArray.size() == 0) {
    logMessage("No devices found in payload");
    return;
  }

  for (JsonObject device : devicesArray) {
    if (!device.containsKey("deviceId") || !device.containsKey("data")) {
      logMessage("Invalid device format");
      continue;
    }

    String deviceId = device["deviceId"].as<String>();
    JsonObject data = device["data"];
    if (!data.containsKey("value") || !data.containsKey("status")) {
      logMessage("Invalid data format for device: " + deviceId);
      continue;
    }

    int value = data["value"];
    String status = data["status"].as<String>();

    logMessage("=== Device Info ===");
    logMessage("Device ID: " + deviceId);
    logMessage("Value: " + String(value));
    logMessage("Status: " + status);

    if (status == "off") {
      processCommand("off");
    } else {
      processCommand("on");
      unsigned long startTime = millis();
      while (millis() - startTime < 2000) {
        yield();  // Prevent watchdog reset
      }
      if (value >= 16 && value <= 25) {
        processCommand(String(value));
      } else {
        logMessage("Invalid temperature value: " + String(value));
      }
    }
  }
}

void setup() {
  Serial.begin(115200);
  irsend.begin();
  logMessage("Samsung AC Remote Ready (Using Raw IR Data)");
  logMessage("Categories:");
  logMessage("- Power: on, off");
  logMessage("- Temperature: 16, 17, 18, 19, 20, 21, 22, 23, 24, 25");
  connectToWiFi();
}

void loop() {
  ensureWiFiConnected();
  unsigned long now = millis();
  if (now - lastUpdate >= UPDATE_INTERVAL) {
    String payload = getPayload();
    processPayload(payload);
    lastUpdate = now;
  }
}